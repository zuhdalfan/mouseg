## app/build/Kconfig/Kconfig.modules
```kconfig
menu "cmsis_6 (/home/zuhdalfan/Project/zephyr-mouseg/modules/hal/cmsis_6)"
osource "$(ZEPHYR_CMSIS_6_KCONFIG)"
config ZEPHYR_CMSIS_6_MODULE
	bool
	default y
endmenu
menu "hal_nordic (/home/zuhdalfan/Project/zephyr-mouseg/modules/hal/nordic)"
osource "$(ZEPHYR_HAL_NORDIC_KCONFIG)"
config ZEPHYR_HAL_NORDIC_MODULE
	bool
	default y

config ZEPHYR_HAL_NORDIC_MODULE_BLOBS
	bool
endmenu
menu "paw3395 (/home/zuhdalfan/Project/zephyr-mouseg/mouseg-app/app/../../modules/paw3395)"
osource "/home/zuhdalfan/Project/zephyr-mouseg/modules/paw3395/Kconfig"
config ZEPHYR_PAW3395_MODULE
	bool
	default y
endmenu
```

## app/build/Kconfig/Kconfig.sysbuild.modules
```kconfig
config ZEPHYR_CMSIS_6_MODULE
   bool
   default y
config ZEPHYR_HAL_NORDIC_MODULE
   bool
   default y
config ZEPHYR_PAW3395_MODULE
   bool
   default y
```

## app/build/Kconfig/arch/Kconfig
```kconfig
# Load Zephyr Arch Kconfig descriptions.
osource "/home/zuhdalfan/Project/zephyr-mouseg/zephyr/arch/rx/Kconfig"
osource "/home/zuhdalfan/Project/zephyr-mouseg/zephyr/arch/x86/Kconfig"
osource "/home/zuhdalfan/Project/zephyr-mouseg/zephyr/arch/xtensa/Kconfig"
osource "/home/zuhdalfan/Project/zephyr-mouseg/zephyr/arch/sparc/Kconfig"
osource "/home/zuhdalfan/Project/zephyr-mouseg/zephyr/arch/riscv/Kconfig"
osource "/home/zuhdalfan/Project/zephyr-mouseg/zephyr/arch/posix/Kconfig"
osource "/home/zuhdalfan/Project/zephyr-mouseg/zephyr/arch/mips/Kconfig"
osource "/home/zuhdalfan/Project/zephyr-mouseg/zephyr/arch/arm64/Kconfig"
osource "/home/zuhdalfan/Project/zephyr-mouseg/zephyr/arch/arm/Kconfig"
osource "/home/zuhdalfan/Project/zephyr-mouseg/zephyr/arch/arc/Kconfig"
```

## app/build/Kconfig/boards/Kconfig
```kconfig
# Load Zephyr board Kconfig descriptions.
osource "/home/zuhdalfan/Project/zephyr-mouseg/zephyr/boards/nordic/nrf52840dk/Kconfig"
```

## app/build/Kconfig/boards/Kconfig.defconfig
```kconfig
# Load Zephyr board defconfig descriptions.
osource "/home/zuhdalfan/Project/zephyr-mouseg/zephyr/boards/nordic/nrf52840dk/Kconfig.defconfig"
```

## app/build/Kconfig/boards/Kconfig.sysbuild
```kconfig
# Load Sysbuild board Kconfig descriptions.
osource "/home/zuhdalfan/Project/zephyr-mouseg/zephyr/boards/nordic/nrf52840dk/Kconfig.sysbuild"
```

## app/build/Kconfig/soc/Kconfig
```kconfig
# Load Zephyr SoC Kconfig descriptions.
osource "/home/zuhdalfan/Project/zephyr-mouseg/zephyr/soc/xlnx/zynqmp/Kconfig"
osource "/home/zuhdalfan/Project/zephyr-mouseg/zephyr/soc/xlnx/zynq7000/Kconfig"
osource "/home/zuhdalfan/Project/zephyr-mouseg/zephyr/soc/xlnx/versalnet/Kconfig"
osource "/home/zuhdalfan/Project/zephyr-mouseg/zephyr/soc/xlnx/versal2/Kconfig"
osource "/home/zuhdalfan/Project/zephyr-mouseg/zephyr/soc/xen/Kconfig"
osource "/home/zuhdalfan/Project/zephyr-mouseg/zephyr/soc/wch/ch32v/Kconfig"
osource "/home/zuhdalfan/Project/zephyr-mouseg/zephyr/soc/ti/simplelink/Kconfig"
osource "/home/zuhdalfan/Project/zephyr-mouseg/zephyr/soc/ti/mspm0/Kconfig"
osource "/home/zuhdalfan/Project/zephyr-mouseg/zephyr/soc/ti/lm3s6965/Kconfig"
osource "/home/zuhdalfan/Project/zephyr-mouseg/zephyr/soc/ti/k3/Kconfig"
osource "/home/zuhdalfan/Project/zephyr-mouseg/zephyr/soc/telink/tlsr/Kconfig"
osource "/home/zuhdalfan/Project/zephyr-mouseg/zephyr/soc/starfive/jh71xx/Kconfig"
osource "/home/zuhdalfan/Project/zephyr-mouseg/zephyr/soc/st/stm32/Kconfig"
osource "/home/zuhdalfan/Project/zephyr-mouseg/zephyr/soc/snps/qemu_arc/Kconfig"
osource "/home/zuhdalfan/Project/zephyr-mouseg/zephyr/soc/snps/nsim/arc_v/Kconfig"
osource "/home/zuhdalfan/Project/zephyr-mouseg/zephyr/soc/snps/nsim/arc_classic/Kconfig"
osource "/home/zuhdalfan/Project/zephyr-mouseg/zephyr/soc/snps/hsdk4xd/Kconfig"
osource "/home/zuhdalfan/Project/zephyr-mouseg/zephyr/soc/snps/hsdk/Kconfig"
osource "/home/zuhdalfan/Project/zephyr-mouseg/zephyr/soc/snps/emsk/Kconfig"
osource "/home/zuhdalfan/Project/zephyr-mouseg/zephyr/soc/snps/emsdp/Kconfig"
osource "/home/zuhdalfan/Project/zephyr-mouseg/zephyr/soc/snps/arc_iot/Kconfig"
osource "/home/zuhdalfan/Project/zephyr-mouseg/zephyr/soc/silabs/Kconfig"
osource "/home/zuhdalfan/Project/zephyr-mouseg/zephyr/soc/sifive/sifive_freedom/Kconfig"
osource "/home/zuhdalfan/Project/zephyr-mouseg/zephyr/soc/sensry/Kconfig"
osource "/home/zuhdalfan/Project/zephyr-mouseg/zephyr/soc/rockchip/Kconfig"
osource "/home/zuhdalfan/Project/zephyr-mouseg/zephyr/soc/renode/riscv_virtual/Kconfig"
osource "/home/zuhdalfan/Project/zephyr-mouseg/zephyr/soc/renode/cortex_r8_virtual/Kconfig"
osource "/home/zuhdalfan/Project/zephyr-mouseg/zephyr/soc/renesas/smartbond/Kconfig"
osource "/home/zuhdalfan/Project/zephyr-mouseg/zephyr/soc/renesas/rz/Kconfig"
osource "/home/zuhdalfan/Project/zephyr-mouseg/zephyr/soc/renesas/rx/Kconfig"
osource "/home/zuhdalfan/Project/zephyr-mouseg/zephyr/soc/renesas/rcar/Kconfig"
osource "/home/zuhdalfan/Project/zephyr-mouseg/zephyr/soc/renesas/ra/Kconfig"
osource "/home/zuhdalfan/Project/zephyr-mouseg/zephyr/soc/realtek/ec/Kconfig"
osource "/home/zuhdalfan/Project/zephyr-mouseg/zephyr/soc/raspberrypi/rpi_pico/Kconfig"
osource "/home/zuhdalfan/Project/zephyr-mouseg/zephyr/soc/quicklogic/eos_s3/Kconfig"
osource "/home/zuhdalfan/Project/zephyr-mouseg/zephyr/soc/qemu/virt_riscv/Kconfig"
osource "/home/zuhdalfan/Project/zephyr-mouseg/zephyr/soc/qemu/malta/Kconfig"
osource "/home/zuhdalfan/Project/zephyr-mouseg/zephyr/soc/openisa/rv32m1/Kconfig"
osource "/home/zuhdalfan/Project/zephyr-mouseg/zephyr/soc/openhwgroup/cva6/Kconfig"
osource "/home/zuhdalfan/Project/zephyr-mouseg/zephyr/soc/oct/osd32mp15x/Kconfig"
osource "/home/zuhdalfan/Project/zephyr-mouseg/zephyr/soc/nxp/s32/Kconfig"
osource "/home/zuhdalfan/Project/zephyr-mouseg/zephyr/soc/nxp/rw/Kconfig"
osource "/home/zuhdalfan/Project/zephyr-mouseg/zephyr/soc/nxp/mcx/Kconfig"
osource "/home/zuhdalfan/Project/zephyr-mouseg/zephyr/soc/nxp/lpc/Kconfig"
osource "/home/zuhdalfan/Project/zephyr-mouseg/zephyr/soc/nxp/layerscape/Kconfig"
osource "/home/zuhdalfan/Project/zephyr-mouseg/zephyr/soc/nxp/kinetis/Kconfig"
osource "/home/zuhdalfan/Project/zephyr-mouseg/zephyr/soc/nxp/imxrt/Kconfig"
osource "/home/zuhdalfan/Project/zephyr-mouseg/zephyr/soc/nxp/imx/Kconfig"
osource "/home/zuhdalfan/Project/zephyr-mouseg/zephyr/soc/nuvoton/numicro/Kconfig"
osource "/home/zuhdalfan/Project/zephyr-mouseg/zephyr/soc/nuvoton/numaker/Kconfig"
osource "/home/zuhdalfan/Project/zephyr-mouseg/zephyr/soc/nuvoton/npcx/Kconfig"
osource "/home/zuhdalfan/Project/zephyr-mouseg/zephyr/soc/nuvoton/npcm/Kconfig"
osource "/home/zuhdalfan/Project/zephyr-mouseg/zephyr/soc/nordic/Kconfig"
osource "/home/zuhdalfan/Project/zephyr-mouseg/zephyr/soc/neorv32/Kconfig"
osource "/home/zuhdalfan/Project/zephyr-mouseg/zephyr/soc/native/inf_clock/Kconfig"
osource "/home/zuhdalfan/Project/zephyr-mouseg/zephyr/soc/microchip/sam/Kconfig"
osource "/home/zuhdalfan/Project/zephyr-mouseg/zephyr/soc/microchip/miv/Kconfig"
osource "/home/zuhdalfan/Project/zephyr-mouseg/zephyr/soc/microchip/mec/Kconfig"
osource "/home/zuhdalfan/Project/zephyr-mouseg/zephyr/soc/mediatek/mt8xxx/Kconfig"
osource "/home/zuhdalfan/Project/zephyr-mouseg/zephyr/soc/lowrisc/opentitan/Kconfig"
osource "/home/zuhdalfan/Project/zephyr-mouseg/zephyr/soc/litex/litex_vexriscv/Kconfig"
osource "/home/zuhdalfan/Project/zephyr-mouseg/zephyr/soc/ite/ec/Kconfig"
osource "/home/zuhdalfan/Project/zephyr-mouseg/zephyr/soc/intel/raptor_lake/Kconfig"
osource "/home/zuhdalfan/Project/zephyr-mouseg/zephyr/soc/intel/lakemont/Kconfig"
osource "/home/zuhdalfan/Project/zephyr-mouseg/zephyr/soc/intel/intel_socfpga_std/Kconfig"
osource "/home/zuhdalfan/Project/zephyr-mouseg/zephyr/soc/intel/intel_socfpga/Kconfig"
osource "/home/zuhdalfan/Project/zephyr-mouseg/zephyr/soc/intel/intel_niosv/Kconfig"
osource "/home/zuhdalfan/Project/zephyr-mouseg/zephyr/soc/intel/intel_ish/Kconfig"
osource "/home/zuhdalfan/Project/zephyr-mouseg/zephyr/soc/intel/intel_adsp/Kconfig"
osource "/home/zuhdalfan/Project/zephyr-mouseg/zephyr/soc/intel/elkhart_lake/Kconfig"
osource "/home/zuhdalfan/Project/zephyr-mouseg/zephyr/soc/intel/atom/Kconfig"
osource "/home/zuhdalfan/Project/zephyr-mouseg/zephyr/soc/intel/apollo_lake/Kconfig"
osource "/home/zuhdalfan/Project/zephyr-mouseg/zephyr/soc/intel/alder_lake/Kconfig"
osource "/home/zuhdalfan/Project/zephyr-mouseg/zephyr/soc/infineon/cat3/Kconfig"
osource "/home/zuhdalfan/Project/zephyr-mouseg/zephyr/soc/infineon/cat1c/Kconfig"
osource "/home/zuhdalfan/Project/zephyr-mouseg/zephyr/soc/infineon/cat1b/Kconfig"
osource "/home/zuhdalfan/Project/zephyr-mouseg/zephyr/soc/infineon/cat1a/Kconfig"
osource "/home/zuhdalfan/Project/zephyr-mouseg/zephyr/soc/gd/gd32/Kconfig"
osource "/home/zuhdalfan/Project/zephyr-mouseg/zephyr/soc/gaisler/leon3/Kconfig"
osource "/home/zuhdalfan/Project/zephyr-mouseg/zephyr/soc/gaisler/gr716a/Kconfig"
osource "/home/zuhdalfan/Project/zephyr-mouseg/zephyr/soc/espressif/Kconfig"
osource "/home/zuhdalfan/Project/zephyr-mouseg/zephyr/soc/ene/kb1200/Kconfig"
osource "/home/zuhdalfan/Project/zephyr-mouseg/zephyr/soc/ene/kb106x/Kconfig"
osource "/home/zuhdalfan/Project/zephyr-mouseg/zephyr/soc/efinix/sapphire/Kconfig"
osource "/home/zuhdalfan/Project/zephyr-mouseg/zephyr/soc/cdns/xtensa_sample_controller/Kconfig"
osource "/home/zuhdalfan/Project/zephyr-mouseg/zephyr/soc/cdns/sample_controller32/Kconfig"
osource "/home/zuhdalfan/Project/zephyr-mouseg/zephyr/soc/cdns/dc233c/Kconfig"
osource "/home/zuhdalfan/Project/zephyr-mouseg/zephyr/soc/brcm/bcmvk/Kconfig"
osource "/home/zuhdalfan/Project/zephyr-mouseg/zephyr/soc/brcm/bcm2712/Kconfig"
osource "/home/zuhdalfan/Project/zephyr-mouseg/zephyr/soc/brcm/bcm2711/Kconfig"
osource "/home/zuhdalfan/Project/zephyr-mouseg/zephyr/soc/bflb/Kconfig"
osource "/home/zuhdalfan/Project/zephyr-mouseg/zephyr/soc/atmel/sam0/Kconfig"
osource "/home/zuhdalfan/Project/zephyr-mouseg/zephyr/soc/atmel/sam/Kconfig"
osource "/home/zuhdalfan/Project/zephyr-mouseg/zephyr/soc/aspeed/Kconfig"
osource "/home/zuhdalfan/Project/zephyr-mouseg/zephyr/soc/arm/Kconfig"
osource "/home/zuhdalfan/Project/zephyr-mouseg/zephyr/soc/arm/beetle/Kconfig"
osource "/home/zuhdalfan/Project/zephyr-mouseg/zephyr/soc/antmicro/myra/Kconfig"
osource "/home/zuhdalfan/Project/zephyr-mouseg/zephyr/soc/andestech/Kconfig"
osource "/home/zuhdalfan/Project/zephyr-mouseg/zephyr/soc/amd/acp_6_0/Kconfig"
osource "/home/zuhdalfan/Project/zephyr-mouseg/zephyr/soc/ambiq/Kconfig"
osource "/home/zuhdalfan/Project/zephyr-mouseg/zephyr/soc/aesc/Kconfig"
osource "/home/zuhdalfan/Project/zephyr-mouseg/zephyr/soc/adi/max32/Kconfig"
```

## west.yml
```yaml
# Copyright (c) 2021 Nordic Semiconductor ASA
# SPDX-License-Identifier: Apache-2.0

manifest:
  self:
    west-commands: scripts/west-commands.yml

  remotes:
    - name: zephyrproject-rtos
      url-base: https://github.com/zephyrproject-rtos
    - name: zuhdalfan
      url-base: https://github.com/zuhdalfan

  projects:
    - name: zephyr
      remote: zephyrproject-rtos
      revision: main
      import:
        name-allowlist:
          - cmsis_6
          - hal_nordic

    - name: paw3395
      remote: zuhdalfan        # ✅ use remote name here
      revision: main
      path: modules/paw3395
```
